## config/boards/arm/gmmk_pro/Kconfig.board
```kconfig
config BOARD_GMMK_PRO
    def_bool $(boards_list_contains,gmmk_pro)
    select SOC_STM32F303XC
```

## config/boards/arm/gmmk_pro/Kconfig.defconfig
```kconfig
if BOARD_GMMK_PRO
    config ZMK_KEYBOARD_NAME
        default "GMMK Pro"

    config ZMK_KSCAN_MATRIX_POLLING
        default y
endif
```

## config/west.yml
```yaml
manifest:
  remotes:
    - name: zmkfirmware
      url-base: https://github.com/zmkfirmware
    - name: G3rtz
      url-base: https://github.com/G3rtz
  projects:
    - name: zmk
      remote: zmkfirmware
      revision: main
      import: app/west.yml
    - name: zmk-board-gmmk-pro
      remote: G3rtz
      revision: main
    - name: zmk-module-aw20216s
      remote: G3rtz
      revision: main

  self:
    path: config
```
